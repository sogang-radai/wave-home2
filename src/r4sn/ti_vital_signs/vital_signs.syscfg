/**
 * @cliArgs --device "XWRL64XX" --package "FCCSP" --part "Default" --context "m4fss0-0" --product "MMWAVE-L-SDK@05.00.00"
 * @versions {"tool":"1.17.0+3128"}
 */

/**
 * Import the modules used in this configuration.
 */
const flash      = scripting.addModule("/board/flash/flash", {}, false);
const flash1     = flash.addInstance();
const ina        = scripting.addModule("/board/ina/ina", {}, false);
const ina1       = ina.addInstance();
const ina2       = ina.addInstance();
const ina3       = ina.addInstance();
const mpd_demo   = scripting.addModule("/demo/mpd_demo/mpd_demo", {}, false);
const mpd_demo1  = mpd_demo.addInstance();
const edma       = scripting.addModule("/drivers/edma/edma", {}, false);
const edma1      = edma.addInstance();
const edma2      = edma.addInstance();
const gpio       = scripting.addModule("/drivers/gpio/gpio", {}, false);
const gpio1      = gpio.addInstance();
const hwa        = scripting.addModule("/drivers/hwa/hwa", {}, false);
const hwa1       = hwa.addInstance();
const i2c        = scripting.addModule("/drivers/i2c/i2c", {}, false);
const i2c1       = i2c.addInstance();
const power      = scripting.addModule("/drivers/power/power", {}, false);
const power1     = power.addInstance();
const uart       = scripting.addModule("/drivers/uart/uart", {}, false);
const uart1      = uart.addInstance();
const mpu_armv7  = scripting.addModule("/kernel/dpl/mpu_armv7", {}, false);
const mpu_armv71 = mpu_armv7.addInstance();
const mpu_armv72 = mpu_armv7.addInstance();
const mpu_armv73 = mpu_armv7.addInstance();
const mpu_armv74 = mpu_armv7.addInstance();
const timer      = scripting.addModule("/kernel/dpl/timer", {}, false);
const timer1     = timer.addInstance();

/**
 * Write custom configuration values to the imported modules.
 */
flash1.$name                  = "CONFIG_FLASH0";
flash1.peripheralDriver.$name = "CONFIG_QSPI0";

ina1.$name = "CONFIG_INA0";

ina2.$name            = "CONFIG_INA1";
ina2.I2CTargetAddress = "0x41";

ina3.$name            = "CONFIG_INA2";
ina3.I2CTargetAddress = "0x44";
ina3.shuntRes         = 20;

mpd_demo1.$name = "CONFIG_MPD_DEMO0";

edma2.$name                        = "CONFIG_EDMA1";
edma2.edmaRmDmaCh[0].$name         = "CONFIG_EDMA_RM5";
edma2.edmaRmQdmaCh[0].$name        = "CONFIG_EDMA_RM6";
edma2.edmaRmTcc[0].$name           = "CONFIG_EDMA_RM7";
edma2.edmaRmParam[0].$name         = "CONFIG_EDMA_RM8";
edma2.edmaRmReservedDmaCh[0].$name = "CONFIG_EDMA_RM9";

gpio1.pinDir               = "OUTPUT";
gpio1.$name                = "GPIO_LED";
gpio1.GPIO.$assign         = "GPIO";
gpio1.GPIO.gpioPin.$assign = "PAD_AV";

hwa1.$name = "CONFIG_HWA0";

i2c1.$name = "CONFIG_I2C0";

power1.$name                        = "CONFIG_POWER0";
power1.enterLPDSHookFunction        = "power_LPDSentryhook";
power1.resumeLPDSHookFunction       = "power_LPDSresumehook";
power1.enableSleepCounterWakeupLPDS = true;
power1.thresholdForSleep            = 99999999;
power1.totalLatencyForSleep         = 99999999;
power1.ramRetentionMaskLPDS         = ["APP_PD_SRAM_CLUSTER_1","APP_PD_SRAM_CLUSTER_2","APP_PD_SRAM_CLUSTER_3","APP_PD_SRAM_CLUSTER_4","APP_PD_SRAM_CLUSTER_5","APP_PD_SRAM_CLUSTER_6","FEC_PD_SRAM_CLUSTER_1"];
power1.enteridle3HookFunction       = "power_idle3entryhook";
power1.resumeidle3HookFunction      = "power_idle3resumehook";
power1.parkPins.$name               = "drivers_power_v0_power_v0_pins0";
power1.parkPins.changeAllPins       = "PARK";
power1.parkPins.PAD_AQ              = "DONT_PARK";
power1.parkPins.PAD_AR              = "DONT_PARK";
power1.parkPins.PAD_AS              = "DONT_PARK";
power1.parkPins.PAD_AT              = "DONT_PARK";
power1.parkPins.PAD_AV              = "DONT_PARK";

uart1.$name           = "CONFIG_UART0";
uart1.intrEnable      = "DISABLE";
uart1.UART.RX.$assign = "PAD_AP";
uart1.UART.TX.$assign = "PAD_AO";

edma1.$name                        = "CONFIG_EDMA0";
uart1.edmaConfig                   = edma1;
flash1.peripheralDriver.edmaConfig = edma1;
edma1.instance                     = "EDMA_APPSS_B";
edma1.edmaRmDmaCh[0].$name         = "CONFIG_EDMA_RM0";
edma1.edmaRmQdmaCh[0].$name        = "CONFIG_EDMA_RM1";
edma1.edmaRmTcc[0].$name           = "CONFIG_EDMA_RM2";
edma1.edmaRmParam[0].$name         = "CONFIG_EDMA_RM3";
edma1.edmaRmReservedDmaCh[0].$name = "CONFIG_EDMA_RM4";

mpu_armv71.$name        = "CONFIG_MPU_REGION0";
mpu_armv71.attributes   = "Device";
mpu_armv71.allowExecute = false;

mpu_armv72.$name    = "CONFIG_MPU_REGION1";
mpu_armv72.baseAddr = 0x400000;
mpu_armv72.size     = 19;

mpu_armv73.$name    = "CONFIG_MPU_REGION2";
mpu_armv73.baseAddr = 0x22400000;
mpu_armv73.size     = 19;

mpu_armv74.$name             = "CONFIG_MPU_REGION3";
mpu_armv74.accessPermissions = "Supervisor RD, User RD";
mpu_armv74.size              = 18;

timer1.$name         = "CONFIG_TIMER0";
timer1.timerCallback = "timerCallbackDefcfg";

/**
 * Pinmux solution for unlocked pins/peripherals. This ensures that minor changes to the automatic solver in a future
 * version of the tool will not impact the pinmux you originally saw.  These lines can be completely deleted in order to
 * re-solve from scratch.
 */
flash1.peripheralDriver.QSPI.$suggestSolution      = "QSPI0";
flash1.peripheralDriver.QSPI.DOUT.$suggestSolution = "PAD_AC";
flash1.peripheralDriver.QSPI.DIN.$suggestSolution  = "PAD_AD";
flash1.peripheralDriver.QSPI.DIN0.$suggestSolution = "PAD_AE";
flash1.peripheralDriver.QSPI.DIN1.$suggestSolution = "PAD_AF";
flash1.peripheralDriver.QSPI.CLK.$suggestSolution  = "PAD_AA";
flash1.peripheralDriver.QSPI.CS.$suggestSolution   = "PAD_AB";
i2c1.I2C.$suggestSolution                          = "I2C0";
i2c1.I2C.SCL.$suggestSolution                      = "PAD_AG";
i2c1.I2C.SDA.$suggestSolution                      = "PAD_AH";
uart1.UART.$suggestSolution                        = "UARTB";
timer1.APPSS_RTI.$suggestSolution                  = "APPSS_RTIA";
